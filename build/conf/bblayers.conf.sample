## build/conf/bblayers.conf.sample
```bitbake
# LAYER_CONF_VERSION is increased each time build/conf/bblayers.conf
# changes incompatibly
LCONF_VERSION = "7"

BBPATH = "${TOPDIR}"
BBFILES ?= ""

BBLAYERS ?= " \
  ##OEROOT##/meta \
  ##OEROOT##/meta-poky \
  ##OEROOT##/../meta-openembedded/meta-oe \
  ##OEROOT##/../meta-openembedded/meta-gnome \
  ##OEROOT##/../meta-openembedded/meta-python \
  ##OEROOT##/../meta-openembedded/meta-networking \
  ##OEROOT##/../meta-openembedded/meta-multimedia \
  ##OEROOT##/../meta-mxxf1 \
  ##OEROOT##/../meta-qt5 \
  ##OEROOT##/../meta-freescale \
  ##OEROOT##/../meta-freescale-distro \
  ##OEROOT##/../meta-imx/meta-bsp \
  ##OEROOT##/../meta-imx/meta-sdk \
  ##OEROOT##/../meta-python2 \
"
BBMASK = "meta-imx/meta-bsp/recipes-kernel/kernel-modules/*"
```

## meta-mxxf1/conf/distro/dr-distro.conf
```bitbake
DISTRO_VERSION = "DR Honister"
DISTRO_NAME = "DR imx6 distro"

DISTRO_FEATURES_DEFAULT = "systemd opengl fbdev alsa usbgadget usbhost wifi xattr zeroconf pam bluetooth polkit github-private"

require conf/distro/poky.conf

INIT_MANAGER = "systemd"
DISTRO_FEATURES:remove = "wayland vulkan pulseaudio sysvinit"
PACKAGECONFIG:remove:pn-systemd = "\
	vconsole \
	quotacheck \
	hibernate \
	ima \
	smack \
"

PACKAGECONFIG:pn-libgpiod = "cxx python3"
PACKAGECONFIG:append:pn-qtbase = " accessibility fontconfig linuxfb"
LICENSE_FLAGS_WHITELIST:append = " non-commercial"
```

## meta-mxxf1/conf/layer.conf
```bitbake
# We have a conf and classes directory, add to BBPATH
BBPATH .= ":${LAYERDIR}"

# We have a packages directory, add to BBFILES
BBFILES += "${LAYERDIR}/recipes-*/*/*.bb \
            ${LAYERDIR}/recipes-*/*/*.bbappend"

BBFILE_COLLECTIONS += "mxxf1"
BBFILE_PATTERN_mxxf1 := "^${LAYERDIR}/"
BBFILE_PRIORITY_mxxf1 = "8"

LAYERSERIES_COMPAT_mxxf1 = "kirkstone"

# Let us add layer-specific bbappends which are only applied when that
# layer is included in our configuration
BBFILES += "${@' '.join('${LAYERDIR}/%s/recipes*/*/*.bbappend' % layer \
               for layer in BBFILE_COLLECTIONS.split())}"
# Add layer-specific bb files too
BBFILES += "${@' '.join('${LAYERDIR}/%s/recipes*/*/*.bb' % layer \
               for layer in BBFILE_COLLECTIONS.split())}"

DR_GIT_MIRROR ?= "git://git@bitbucket.datarespons.com:7999/no_imx"
DR_BITBUCKET_MIRROR_IMX ?= "git://git@bitbucket.datarespons.com:7999/no_imx/"

DR_OEMSW_SHA = "c1b5a974a34d4b93b09b01c9976951692844c8cb"
```

## meta-mxxf1/conf/machine/dr-imx6-mc.conf
```bitbake
#@TYPE: Machine
#@NAME: i.MX6Q MXXF1
#@DESCRIPTION: Machine configuration for DATARESPONS i.MX6Q MXXF1

MACHINEOVERRIDES =. "mx6:mx6q:"
IMX_DEFAULT_BSP = "nxp"

require conf/machine/include/imx-base.inc
require conf/machine/include/arm/armv7a/tune-cortexa9.inc

KERNEL_DEVICETREE = "mxxf1.dtb mxxf1-tsup.dtb mxxf1-hw4.dtb"

SERIAL_CONSOLES = "115200;ttymxc0"

MACHINE_FEATURES = "pci wifi ext2 vfat usbgadget usbhost"
MACHINE_ESSENTIAL_EXTRA_RDEPENDS += "kernel-devicetree kernel-modules imx6-fixup"
MACHINE_EXTRA_RRECOMMENDS += "mxxf1-hostname ${@bb.utils.contains('DISTRO_FEATURES', 'x11', '', 'qt5-eglfs-mxxf1', d)}"
IMAGE_OVERHEAD_FACTOR = "2.0"
IMAGE_FSTYPES = "tar.bz2"

KERNEL_IMAGETYPE = "zImage"
MACHINE_USES_VIVANTE_KERNEL_DRIVER_MODULE = "0"
PREFERRED_PROVIDER_virtual/bootloader = "barebox"
BAREBOX_CONFIG = "dr-mxxf1_defconfig"
```
